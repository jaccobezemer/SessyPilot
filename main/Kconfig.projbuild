## main/Kconfig.projbuild
```kconfig
menu "Example Configuration"
    config EXAMPLE_DOUBLE_FB
        bool "Use double Frame Buffer"
        default "n"
        help
            Enable this option, driver will allocate two frame buffers.

    config EXAMPLE_USE_BOUNCE_BUFFER
        depends on !EXAMPLE_DOUBLE_FB
        bool "Use bounce buffer"
        help
            Enable bounce buffer mode can achieve higher PCLK frequency at the cost of higher CPU consumption.

    config EXAMPLE_AVOID_TEAR_EFFECT_WITH_SEM
        depends on !EXAMPLE_DOUBLE_FB
        bool "Avoid tearing effect"
        default "y"
        help
            Enable this option, the example will use a pair of semaphores to avoid the tearing effect.
            Note, if the Double Frame Buffer is used, then we can also avoid the tearing effect without the lock.
endmenu

menu "Sessy Controller Configuration"
    config SESSY_HOSTNAME
        string "Device hostname (mDNS / DHCP)"
        default "Sessy-Controller"
        help
            Hostname of this device on the local network.
            Visible in router DHCP table and reachable as <hostname>.local via mDNS.

    config SESSY_WIFI_SSID
        string "Default WiFi SSID"
        default "MyNetwork"
        help
            Default WiFi SSID. Can be overridden from the touchscreen settings.

    config SESSY_WIFI_PASSWORD
        string "Default WiFi Password"
        default ""
        help
            Default WiFi password. Can be overridden from the touchscreen settings.

    config SESSY_DONGLE_HOSTNAME
        string "Sessy Dongle hostname or IP (blank = mDNS)"
        default ""
        help
            If set, connect directly to this Sessy Dongle instead of using mDNS.
            Example: 192.168.1.42 or sessy-ABCD.local

    config SESSY_P1_HOSTNAME
        string "Sessy P1 Meter hostname or IP (blank = mDNS)"
        default ""
        help
            If set, connect directly to this Sessy P1 Meter instead of using mDNS.
            Example: 192.168.1.43 or sessy-EFGH.local

    config SESSY_USERNAME
        string "Sessy Username (from dongle sticker)"
        default "DDGHC47E"
        help
        Username van Sessy dongle (bijv. DDGHC47E)

    config SESSY_PASSWORD
        string "Sessy Password (from dongle sticker)" 
        default "XUSQS56C"
        help
        Password van Sessy dongle (bijv. XUSQS56C)

    config SESSY_POLL_INTERVAL_MS
        int "Status polling interval in milliseconds"
        default 5000
        range 1000 60000
        help
            How often to poll the Sessy power status API.

    config SESSY_ENERGY_POLL_INTERVAL_MS
        int "Energy polling interval in milliseconds"
        default 30000
        range 5000 300000
        help
            How often to poll the Sessy energy meters API.

    config SESSY_CAR_CHARGE_THRESHOLD
        int "Car charge detection threshold in Watts"
        default 9000
        range 500 20000
        help
            Power threshold (Watts) above which a car is assumed to be charging.
            Total house consumption is calculated as P1 net power + solar production + Sessy battery power.

    config SESSY_CAR_CHARGE_STOP_DELAY
        int "Car charge stop detection delay in minutes"
        default 2
        range 1 30
        help
            How many minutes power must stay below the threshold before
            car charging is reported as stopped. This accounts for the
            gradual ramp-down of EV chargers.

    config SESSY_SCREEN_DIM
        int "Screen software dim level (0-90%)"
        default 30
        range 0 90
        help
            Software overlay dim level as a percentage (0 = no dim, 90 = very dark).
            Applied on top of the hardware backlight. Adjustable at runtime in Settings.

    config SESSY_SOLAR_MAX_W
        int "Maximum solar panel output in Watts (arc scale)"
        default 3000
        range 500 30000
        help
            Maximum solar production capacity in Watts.
            Used as the full-scale value for the solar arc on the Status screen.

    config SESSY_IDLE_AT_SOC_ZERO
        bool "Treat SOC == 0% as Sessy Idle"
        default y
        help
            When enabled, the Auto Laden button is shown as active (green)
            when the Sessy state-of-charge is 0% in addition to when the
            strategy is IDLE. Can be toggled via the SDK Configuration Editor.
endmenu
```

## sdkconfig.defaults
```kconfig
CONFIG_LV_MEM_CUSTOM=y
CONFIG_LV_MEMCPY_MEMSET_STD=y
CONFIG_LV_USE_USER_DATA=y
CONFIG_LV_USE_CHART=y
CONFIG_LV_USE_PERF_MONITOR=n

# LVGL fonts for Sessy UI
CONFIG_LV_FONT_MONTSERRAT_12=y
CONFIG_LV_FONT_MONTSERRAT_14=y
CONFIG_LV_FONT_MONTSERRAT_16=y
CONFIG_LV_FONT_MONTSERRAT_22=y
CONFIG_LV_FONT_MONTSERRAT_32=y

# LVGL widgets
CONFIG_LV_USE_TABVIEW=y
CONFIG_LV_USE_ARC=y
CONFIG_LV_USE_SLIDER=y
CONFIG_LV_USE_BTNMATRIX=y
CONFIG_LV_USE_TEXTAREA=y
CONFIG_LV_USE_KEYBOARD=y
CONFIG_LV_USE_MSGBOX=y
CONFIG_LV_USE_LABEL=y
CONFIG_LV_USE_BTN=y

# Main task stack
CONFIG_ESP_MAIN_TASK_STACK_SIZE=8192
```
